#define ZMK_POINTING_DEFAULT_MOVE_VAL 1200  // 600
#define ZMK_POINTING_DEFAULT_SCRL_VAL 35    // 10

#include <input/processors.dtsi>
#include <zephyr/dt-bindings/input/input-event-codes.h>
#include <behaviors.dtsi>

#include <dt-bindings/zmk/bt.h>
#include <dt-bindings/zmk/keys.h>
#include <dt-bindings/zmk/outputs.h>
#include <dt-bindings/zmk/pointing.h>
#include <dt-bindings/zmk/rgb.h>
#include <dt-bindings/zmk/behaviors.h>

// #include <zmk-helpers/helper.h> // Requires zmk-helpers module.
// #include <zmk-helpers/key-labels/eyelashsofle.h> // Requires zmk-helpers module.
#include "include/zmk-helpers/helper.h"
#include "include/zmk-helpers/key-labels/eyelashsofle.h"

#define _BT_SEL_KEYS_ \ &bt BT_SEL 0 &bt BT_SEL 1 &bt BT_SEL 2 &bt BT_SEL 3 &bt BT_CLR
#define DEF 0
#define NUM 1
#define NAV 2
#define SYS 3
#define MOUSE 5
#define FN 6

#define XXX &none
#define ___ &trans

/*  -------------- */
/* Global defaults */
/*  -------------- */

#define QUICK_TAP_MS 175

&sk { // Sticky Key
  release-after-ms = <900>;
  quick-release;
};

&sl { // Sticky Layer - Allow sticky mods to chord across sticky layers.
  ignore-modifiers;
};

&lt { // Layer Tap
  flavor = "balanced";
  tapping-term-ms = <300>;
  quick-tap-ms = <QUICK_TAP_MS>;
};

/* ---------------- */
/* Custom Behaviors */
/* ---------------- */

#include "behaviors/mouse.dtsi"

// Smart-mouse, requires tri-state module.
ZMK_TRI_STATE(
    smart_mouse, bindings = <&tog MOUSE>, <&none>, <&tog MOUSE>;
    ignored-key-positions =
        <LT1 LT2 LH0 LH1 RT1 RT2 RT3 RM0 RM1 RM2 RM3 RM4 RB1 RB2 RB3 RH0 RH1>;
    ignored-layers = <MOUSE NAV FN>;)

#include "behaviors/home_row_mods.dtsi" 

// Hack: Make HRM combos tap-only (cf, ZMK issue #544).
#define ZMK_COMBO_8(NAME, TAP, POS, LAYERS, COMBO_MS, IDLE_MS, HOLD, SIDE)     \
  MAKE_HRM(hm_combo_##NAME, &kp, TAP, SIDE THUMBS)                             \
  ZMK_COMBO_6(NAME, &hm_combo_##NAME HOLD 0, POS, LAYERS, COMBO_MS, IDLE_MS)

#include "behaviors/macros.dtsi"
#include "behaviors/combos.dtsi"  // Must be sourced after HRM-combo hack.
#include "behaviors/num_word.dtsi" 
// #include "behaviors/nav_word.dtsi" 

/* Nav cluster */

// Trigger tap-action on all interrupts.
#define MT_CORE                                                                \
  flavor = "tap-preferred";                                                    \
  tapping-term-ms = <320>;                                                     \
  quick-tap-ms = <320>;                                                        \
  hold-trigger-key-positions = <0>;

&mt { MT_CORE };

ZMK_HOLD_TAP(mt_home, bindings = <&masked_home>, <&kp>; MT_CORE)
ZMK_HOLD_TAP(mt_end, bindings = <&masked_end>, <&kp>; MT_CORE)

#define NAV_LEFT  &mt_home 0   LEFT  // Tap: left  | Long-tap: start of line.
#define NAV_RIGHT &mt_end 0    RIGHT // Tap: right | Long-tap: end   of line.
#define NAV_UP    &mt LC(HOME) UP    // Tap: up    | Long-tap: start of doc.
#define NAV_DOWN  &mt LC(END)  DOWN  // Tap: down  | Long-tap: end   of doc.
#define NAV_BSPC  &mt LC(BSPC) BSPC  // Tap: bspc  | Long-tap: delete word bwd.
#define NAV_DEL   &mt LC(DEL)  DEL   // Tap: del   | Long-tap: delete word fwd.

// Mask CTRL on left/right hold to avoid accidental jumps to start/end of doc.
#define MASK_MODS(NAME, MODS, BINDING)                                         \
  ZMK_MOD_MORPH(NAME, bindings = <BINDING>, <BINDING>; mods = <MODS>;)

MASK_MODS(masked_home, (MOD_LCTL), &kp HOME)
MASK_MODS(masked_end,  (MOD_LCTL), &kp END)

/* Custom behaviors */

#include "behaviors/magic_shift.dtsi"
#include "behaviors/super_copy.dtsi"

// Define mod-morph with a *single* mod trigger for less repetition.
#define SIMPLE_MORPH(NAME, MOD, BINDING1, BINDING2)                            \
  ZMK_MOD_MORPH(NAME, mods = <(MOD_L##MOD | MOD_R##MOD)>;                      \
                bindings = <BINDING1>, <BINDING2>;)

// Tap: comma | Shift + tap: semicolon | Ctrl + shift + tap: <. 
SIMPLE_MORPH(comma_morph, SFT, &kp COMMA, &comma_inner_morph)
SIMPLE_MORPH(comma_inner_morph, CTL, &kp SEMICOLON, &kp LESS_THAN)

// Tap: dot | Shift + tap: colon | Ctrl + shift + tap: >. 
SIMPLE_MORPH(dot_morph, SFT, &kp DOT, &dot_inner_morph)
SIMPLE_MORPH(dot_inner_morph, CTL, &kp COLON, &kp GREATER_THAN)

// Tap: qmark | Shift + tap: excl. 
SIMPLE_MORPH(qexcl, SFT, &kp QMARK, &kp EXCL)

// Tap: left/right parenthesis | Shft + tap: less-than/greater-than. 
SIMPLE_MORPH(lpar_lt, SFT, &kp LPAR, &kp LT)
SIMPLE_MORPH(rpar_gt, SFT, &kp RPAR, &kp GT)

// Tap: $ | Shft + tap: €. 
SIMPLE_MORPH(dllr_eur, SFT, &kp DLLR, &kp RA(N5))

// Tap: space | Shift + tap: dot -> space -> sticky shift | Hold: num layer.  
ZMK_HOLD_TAP(lt_spc, bindings = <&mo>, <&spc_morph>; flavor = "balanced";
             tapping-term-ms = <300>; quick-tap-ms = <QUICK_TAP_MS>;)
SIMPLE_MORPH(spc_morph, SFT, &kp SPACE, &dot_spc)
ZMK_MACRO(dot_spc, bindings = <&kp DOT &kp SPACE &sk LSHFT>; wait-ms = <0>;
          tap-ms = <5>;)

// Tap: qu | Shift + tap: Qu | Hold: q  
ZMK_MOD_MORPH(qu_morph, bindings = <&qu_q>, <&qu_cap>; mods = <(MOD_LSFT|MOD_RSFT)>;)
ZMK_HOLD_TAP(qu_q_holdtap, bindings = <&kp>, <&qu_morph>; flavor = "tap-preferred";
             tapping-term-ms = <300>; quick-tap-ms = <QUICK_TAP_MS>;)

// Tap: backspace | Lshft + tap: delete | Rshft + tap: shift-delete. 
ZMK_MOD_MORPH(bs_del, bindings = <&kp BSPC>, <&kp DEL>;
              mods = <(MOD_LSFT|MOD_RSFT)>; keep-mods = <MOD_RSFT>;)

// Tap: Undo | Double-tap: Redo
// ZMK_TAP_DANCE(undo_redo, bindings = <&undo>, <&redo>;
//               tapping-term-ms = <300>;)

// Tap: Undo | Shift-tap: Redo
SIMPLE_MORPH(undo_redo, SFT, &undo, &redo)

// Sticky shift + leader
// ZMK_MACRO(leader_sft, bindings = <&sk LSHFT &leader>;)

// Misc aliases
#define CANCEL    &kp K_CANCEL            // Cancel caps-word & auto-layers.
// #define DSK_PREV  &hmr LCTRL LG(LC(LEFT)) // Previous desktop.
// #define DSK_NEXT  &hmr LALT LG(LC(RIGHT)) // Next     desktop.
// #define PIN_WIN   &kp LG(LC(LS(Q)))       // Pin window across desktops.
// #define PIN_APP   &kp LG(LC(LS(A)))       // Pin application across desktops.
// #define DSK_MGR   &kp LA(GRAVE)           // Desktop manager.
// #define VOL_DOWN  &hmr RSHFT C_VOL_DN

/* ------ */
/* Keymap */
/* ------ */

// ZMK_CONDITIONAL_LAYER(sys, FN NUM, SYS) // FN + NUM --> SYS.

/ {
    zip_scroll_scaler: zip_scroll_scaler {
        compatible = "zmk,input-processor-scaler";
        #input-processor-cells = <2>;
        type = <INPUT_EV_REL>;
        codes = <INPUT_REL_WHEEL INPUT_REL_HWHEEL>;
        track-remainders;
    };
};

&mmv_input_listener { input-processors = <&zip_xy_scaler 2 1>; };

&msc_input_listener { input-processors = <&zip_scroll_scaler 2 1>; };

&msc {
    acceleration-exponent = <0>;      // 0
    time-to-max-speed-ms = <0>;       // 300
    delay-ms = <0>;                   // 0
};

&mmv {
    time-to-max-speed-ms = <400>;
    acceleration-exponent = <1>;
};

/ {
    scroll_encoder: scroll_encoder {
        compatible = "zmk,behavior-sensor-rotate";
        #sensor-binding-cells = <0>;
        bindings = <&msc SCRL_DOWN>, <&msc SCRL_UP>;

        tap-ms = <30>;
    };

    macros {
        shift_MB3: shift_MB3 {
            compatible = "zmk,behavior-macro";
            #binding-cells = <0>;
            bindings =
                <&macro_press>,
                <&kp LEFT_SHIFT>,
                <&macro_press>,
                <&mkp MB3>,
                <&macro_pause_for_release>,
                <&macro_release>,
                <&mkp MB3 &kp LEFT_SHIFT>;

            label = "SHIFT_MB3";
        };
    };

    behaviors {

    };

    keymap {
        compatible = "zmk,keymap";

        layer0 {
            bindings = <
&kp ESC     &kp N1            &kp N2            &kp N3         &kp N4          &kp N5           &kp UP_ARROW     &kp N6           &kp N7            &kp N8         &kp N9           &kp N0          &kp KP_NUMLOCK
&kp TAB     &qu_q_holdtap Q 0 &kp Y             &kp O          &kp U           &cp_pst_cut      &kp DOWN_ARROW   &kp X            &kp L             &kp D          &kp W            &kp Z           &kp DELETE
&kp B       &hml LGUI  C      &hml LALT I       &hml LSHFT A   &hmr LCTRL E    &kp MINUS        &kp LEFT_ARROW   &kp K            &hmr LCTRL H      &hmr LSHFT T   &hmr LALT N      &hmr LGUI S     &kp F
&mo SYS     &kp SQT           &comma_morph      &qexcl         &dot_morph      SMART_NUM        &kp RIGHT_ARROW  &kp J            &kp M             &kp G          &kp P            &kp V           &tog NUM
&kp C_MUTE  &kp HOME          &kp END           &undo_redo     &lt_spc NUM 0   &lt NAV RET      &kp ENTER        MAGIC_SHIFT      &kp R             &bs_del        &kp PG_DN        &kp PG_UP
            >;

            sensor-bindings = <&inc_dec_kp C_VOLUME_UP C_VOL_DN>;
            display-name = "Enthium";
        };


        layer_1 {
            bindings = <
&trans      &none               &none           &none           &none           &none           &kp UP_ARROW     &none             &none            &none           &none           &none          &trans
&trans      &none               &kp N7          &kp N8          &kp N9          &comma_morph    &kp DOWN_ARROW   &kp X             &kp N7           &kp N8          &kp N9          &none          &trans
&none       &dot_morph          &kp N4          &kp N5          &kp N6          &kp TAB         &kp LEFT_ARROW   &kp TAB           &kp N4           &kp N5          &kp N6          &dot_morph     &none
&none       &none               &kp N1          &kp N2          &kp N3          &kp ENTER       &kp RIGHT_ARROW  &kp ENTER         &kp N1           &kp N2          &kp N3          &comma_morph   &none
&trans      &kp HOME            &kp END         &undo_redo      &kp N0          &kp SPACE       &kp ENTER        &trans             &kp N0           &bs_del         &trans          &trans
            >;

            display-name = "Number";
            sensor-bindings = <&scroll_encoder>;
        };

        layer_2 {
            bindings = <
&none       &kp F1              &kp F2          &kp F3          &kp F4          &kp F5           &mmv MOVE_UP    &kp F6            &kp F7           &kp F8          &kp F9          &kp F10         &kp F11
&none       &kp GRAVE           &none           &none           &none           &mkp MB4         &mmv MOVE_DOWN  &kp PG_UP         &kp END          &kp UP          &kp HOME        &kp MINUS       &kp F12
&none       &kp TILDE           &mkp LCLK       &mkp MCLK       &mkp RCLK       &mkp MB5         &mmv MOVE_LEFT  &kp PG_DN         &kp LEFT         &kp DOWN        &kp RIGHT       &kp LBKT        &kp RBKT
&none       &none               &none           &none           &none           &rgb_ug RGB_SPI  &mmv MOVE_RIGHT &kp INSERT        &none            &none           &none           &none           &none
&trans      &none               &none           &trans          &trans          &trans           &mkp LCLK       &trans            &trans           &trans          &trans          &trans    
            >;

            display-name = "Nav";
            sensor-bindings = <&scroll_encoder>;
        };

        layer_3 {
            bindings = <
&kp ESC     &bt BT_SEL 0        &bt BT_SEL 1    &bt BT_SEL 2   &bt BT_SEL 3     &bt BT_SEL 4     &mmv MOVE_UP     &none             &none           &none           &none           &none            &none
&trans      &bt BT_CLR          &bt BT_CLR_ALL  &none          &none            &none            &mmv MOVE_DOWN   &rgb_ug RGB_OFF   &rgb_ug RGB_ON  &rgb_ug RGB_EFF &rgb_ug RGB_EFR &rgb_ug RGB_SPI  &none 
&trans      &out OUT_USB        &out OUT_BLE    &none          &none            &none            &mmv MOVE_LEFT   &rgb_ug RGB_BRI   &rgb_ug RGB_BRD &none           &none           &none            &none 
&trans      &sys_reset          &soft_off       &bootloader    &none            &none            &mmv MOVE_RIGHT  &none             &none           &bootloader     &soft_off       &sys_reset       &trans
&trans      &none               &none           &trans         &trans           &trans           &mkp LCLK        &trans            &trans          &trans          &trans          &trans
            >;
            display-name = "System";
            sensor-bindings = <&scroll_encoder>;
        };
    };
};



