## config/west.yml
```yaml
manifest:
  remotes:
    - name: zmkfirmware
      url-base: https://github.com/zmkfirmware
    - name: gpeye
      url-base: https://github.com/GPeye
    - name: tokyo2006
      url-base: https://github.com/tokyo2006
    - name: englmaxi
      url-base: https://github.com/englmaxi
    - name: urob
      url-base: https://github.com/urob
  projects:
    - name: zmk
      remote: zmkfirmware
      revision: v0.3.0
      import: app/west.yml
    - name: mario-peripheral-animation
      remote: gpeye
      revision: main 
    - name: prospector-zmk-module                 # <--- and these
      remote: tokyo2006                           # <---
      revision: micro_spi2  
    - name: zmk-dongle-display
      remote: englmaxi
      revision: main

    # ZMK modules
    - name: zmk-adaptive-key
      remote: urob
      revision: v0.3 # Match ZMK version
    - name: zmk-auto-layer
      remote: urob
      revision: v0.3 # Match ZMK version
    - name: zmk-helpers
      remote: urob
      revision: v0.3 # Match ZMK version
    # - name: zmk-leader-key
    #   remote: urob
    #   revision: v0.3 # Match ZMK version
    - name: zmk-unicode
      remote: urob
      revision: v0.3 # Match ZMK version  
    - name: zmk-tri-state
      remote: urob
      revision: v0.3 # Match ZMK version
  self:
    path: config
```
