#include <dt-bindings/zmk/behaviors.h>
#include <dt-bindings/zmk/keys.h>
#include <zmk-helpers/helper.h>

// Hold: Cut | Tap: Copy | Double Tab: Paste
ZMK_TAP_DANCE(cp_pst_cut, bindings = <&mt LC(X) LC(C)>, <&kp LC(V)>; 
              tapping-term-ms = <300>;)